## boards/logotronic/hciu_logotherm_ble/Kconfig.hciu_logotherm_ble
```kconfig
# HCIU Logotherm BLE board configuration
# SPDX-License-Identifier: Apache-2.0

config BOARD_HCIU_LOGOTHERM_BLE
	select SOC_NRF52810_QFAA
```

## boards/logotronic/hciu_logotherm_ble/board.yml
```yaml
board:
  name: hciu_logotherm_ble
  full_name: HCIU Logotherm BLE
  vendor: logotronic
  socs:
    - name: nrf52810
```

## boards/logotronic/hciu_logotherm_main/Kconfig.hciu_logotherm_main
```kconfig
# HCIU Logotherm Main board configuration
# SPDX-License-Identifier: Apache-2.0

config BOARD_HCIU_LOGOTHERM_MAIN
	select SOC_STM32F413XX
```

## boards/logotronic/hciu_logotherm_main/board.yml
```yaml
board:
  name: hciu_logotherm_main
  full_name: HCIU Logotherm Main
  vendor: logotronic
  socs:
    - name: stm32f413xx
```

## west.yml
```yaml
manifest:
  version: "0.13"

  remotes:
    - name: zephyrproject-rtos
      url-base: https://github.com/zephyrproject-rtos

  defaults:
    remote: zephyrproject-rtos

  projects:
    - name: zephyr
      revision: v4.4.0
      west-commands: scripts/west-commands.yml
      import:
        name-whitelist:
          - cmsis
          - cmsis_6
          - hal_nordic
          - hal_stm32
        path-whitelist:
          - modules/hal/cmsis/.*
          - modules/hal/cmsis_6/.*
          - modules/hal/nordic/.*
          - modules/hal/stm32/.*

    - name: cmsis
      path: modules/hal/cmsis
      revision: 512cc7e895e8491696b61f7ba8066b4a182569b8

    - name: cmsis_6
      path: modules/hal/cmsis_6
      revision: 30a859f44ef8ab4dc8f84b03ed586fd16ccf9d74

    - name: hal_nordic
      path: modules/hal/nordic
      revision: 44fd3d44b15cb75f80a25b4679f91d2787e28664

    - name: hal_stm32
      path: modules/hal/stm32
      revision: 39130f29ae37c1db34095478ca02b6419b70dcdc

  self:
    path: .
```
